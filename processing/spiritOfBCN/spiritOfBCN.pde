int sizeX = 25;
int sizeY = 25;
int matrixSizeX = 70;
int matrixSizeY = 40;
int padding = 2;

float[] dataper = new float[200];
String[] datacol = new String[200];
String[] pais = new String[200];
int index;
int yr = 2015;
int loopindex = 0;

int[][][] screenMap = new int[matrixSizeX][matrixSizeY][6]; // 0 used or not 1 R 2 G 3 B 4 Alpha 5 fade in /fade out
// city background
int[] city = {
0x00000000, 0x00000000, 0x00000000, 0x00000000, 0x00000000, 0x00000000, 0x00000000, 0x00000000, 0x00000000, 0x00000000, 0x00000000, 0x00000000,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 0x00000000, 
0x00000000, 0x00000000, 0x00000000, 0x00000000, 0x00000000, 0x00000000, 0x00000000, 0x00000000, 0x00000000, 0x00000000, 0x00000000, 0x00000000,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 0x00000000, 
0x00000000, 0x00000000, 0x00000000, 0x00000000, 0x00000000, 0x00000000, 0x00000000, 0x00000000, 0x00000000, 0x00000000, 0x00000000, 0x00000000,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 0x00000000, 
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0x00000000, 0x00000000, 0x00000000, 0x00000000, 0x00000000, 0x00000000, 0x00000000, 0x00000000, 0x00000000, 0x00000000, 0x00000000, 0x00000000,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 0x00000000
};


void calculateMatrix() {
  color c;
  for (int x=0;x<matrixSizeX;x++) {
    for (int y=0;y<matrixSizeY;y++) {
      c = getElement();
      //println("alpha",x,y,screenMap[x][y][4]);
      if (screenMap[x][y][0]==1) {
        if (screenMap[x][y][4]<=0) {
          if (int(random(20))==1) {
            screenMap[x][y][1]=int(red(c));
            screenMap[x][y][2]=int(green(c));
            screenMap[x][y][3]=int(blue(c));
            screenMap[x][y][4]=1;
            //println("created",x,y);
          }
        } 
        if (screenMap[x][y][4] > 0 && screenMap[x][y][5]==1) {
          screenMap[x][y][4]=screenMap[x][y][4]+5;
          if (screenMap[x][y][4]>=255) { screenMap[x][y][5]=0; }
        }
        if (screenMap[x][y][4] > 0 && screenMap[x][y][5]==0) {
            screenMap[x][y][4]=screenMap[x][y][4]-5;
            if (screenMap[x][y][4]<=0) { screenMap[x][y][5]=1; }
        }
      }
    }
  }
}


void getPaises(int year) {
  index = 0;
  Table data = loadTable("dataOutput"+str(year)+".csv","header");
  for (TableRow row : data.rows()) {
    float num = row.getFloat("numero");
    String col = row.getString("color");
    String p = row.getString("pais");
    dataper[index]=num;
    datacol[index]=col;
    pais[index]=p;
    index++;
   }
}

color getElement() {
  float rd = random(100);
  float total = 0.0;
  String theColor = "000000";
  for (int i=0;i<index;i++) {
    float num = dataper[i];
    total = total + num;
    if (total>rd) {
      theColor = datacol[i];
      break;
    }
  }
  color c = unhex("FF" + theColor);
  return c;
}


void setup() {
  size(1920,1080);
   for (int x=0;x<matrixSizeX;x++) {
    for (int y=0;y<matrixSizeY;y++) {
      if (hex(city[(y*70)+x]).equals("FF000000")) { screenMap[x][y][0]=1; } else { screenMap[x][y][0]=0; } // mapping the shape of the city
      screenMap[x][y][1]=0;
      screenMap[x][y][2]=0;
      screenMap[x][y][3]=0;
      screenMap[x][y][4]=0;
      screenMap[x][y][5]=1;
    }
  }
  getPaises(2015);
}

void draw() {
  
  background(0);
  
  loopindex++;
  if (loopindex == 1000) {
    loopindex=0;
    yr++;
    if (yr==2020) { yr=2015;}
    getPaises(yr);
  }
  
  calculateMatrix();
  for (int x=0;x<matrixSizeX;x++) {
    for (int y=0;y<matrixSizeY;y++) {
      fill(screenMap[x][y][1],screenMap[x][y][2],screenMap[x][y][3],screenMap[x][y][4]);
      //fill(255,0,0);
      rect(x*(sizeX+padding), y*(sizeX+padding), sizeX, sizeX);
    }
  }
  textSize(42);
  fill(180,180,180,50);
  rect(1200,40,720,90);
  fill(160, 162, 163,188);
  text("the spirit of Barcelona", 1230, 100);
  //textSize(32);
  //text("Any "+str(yr)+" (els 40 països principals)",80,50);
  textSize(70);
  text(str(yr),300,230);
  textSize(10);
  for (int i=0;i<index;i++) {
    color c = unhex("FF" + datacol[i]);
    fill(red(c), green(c), blue(c));
    rect(10,8+(i*10),8,8);
    fill(255, 255, 255);
    text(pais[i]+" "+nf(dataper[i],0,2)+"%", 30, 15+(i*10));
  }   
}
